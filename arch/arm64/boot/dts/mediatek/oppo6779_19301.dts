/*
 * Mediatek's mt6779 SoC device tree source
 *
 * Copyright (C) 2018 MediaTek Inc.
 *
 * This program is free software; you can redistribute it and/or modify
 * it under the terms of the GNU General Public License version 2 as
 * published by the Free Software Foundation.
 *
 * This program is distributed in the hope that it will be useful,
 * but WITHOUT ANY WARRANTY; without even the implied warranty of
 * MERCHANTABILITY or FITNESS FOR A PARTICULAR PURPOSE.
 * See http://www.gnu.org/licenses/gpl-2.0.html for more details.
 */

/dts-v1/;
/plugin/;
#include <dt-bindings/interrupt-controller/irq.h>
#include <dt-bindings/interrupt-controller/arm-gic.h>
#include <dt-bindings/pinctrl/mt6779-pinfunc.h>

/* chosen */
&chosen {

	atag,videolfb-fb_base_l = <0x5e605000>;
	atag,videolfb-fb_base_h = <0x0>;
	atag,videolfb-islcmfound = <1>;
	atag,videolfb-islcm_inited = <0>;
	atag,videolfb-fps= <6000>;
	atag,videolfb-vramSize= <0x017bb000>;
	atag,videolfb-lcmname=
		"nt35595_fhd_dsi_cmd_truly_nt50358_drv";
};

&odm {
	led0:led@0 {
		compatible = "mediatek,red";
		led_mode = <0>;
		data = <1>;
		pwm_config = <0 0 0 0 0>;
	};
	led1:led@1 {
		compatible = "mediatek,green";
		led_mode = <0>;
		data = <1>;
		pwm_config = <0 0 0 0 0>;
	};
	led2:led@2 {
		compatible = "mediatek,blue";
		led_mode = <0>;
		data = <1>;
		pwm_config = <0 0 0 0 0>;
	};
	led3:led@3 {
		compatible = "mediatek,jogball-backlight";
		led_mode = <0>;
		data = <1>;
		pwm_config = <0 0 0 0 0>;
	};
	led4:led@4 {
		compatible = "mediatek,keyboard-backlight";
		led_mode = <0>;
		data = <1>;
		pwm_config = <0 0 0 0 0>;
	};
	led5:led@5 {
		compatible = "mediatek,button-backlight";
		led_mode = <0>;
		data = <1>;
		pwm_config = <0 0 0 0 0>;
	};
	led6:led@6 {
		compatible = "mediatek,lcd-backlight";
		/* #ifndef VENDOR_EDIT */
		/* Yongpeng.Yi@PSW.MM.Display.LCD.Machine, 2018/11/05, Add for 18151 lcd driver */
		/* led_mode = <5>; */
		/* #else VENDOR_EDIT */
		led_mode = <4>;
		/* #endif VENDOR_EDIT */
		data = <1>;
		pwm_config = <0 1 0 0 0>;
	};
	vibrator0:vibrator@0 {
		compatible = "mediatek,vibrator";
		/*
		vib_timer = <25>;
		vib_limit = <9>;
		vib_vol= <9>;
		*/
		vib_timer = <30>; /*xing.xiong@BSP.Kernel.Driver, 2018/12/08, Add for vibrator*/
		vib_limit = <0>;
		vib_vol= <11>;
	};

	usb_c_pinctrl:usb_c_pinctrl {
		compatible = "mediatek,usb_c_pinctrl";
	};

/*VENDOR_EDIT keypad start*/
/*Bin.Li@EXP.BSP.bootloader.bootflow, 2017/05/16, Add volume up and down */
	kpd_volume_up:kpd_volume_up {
		compatible = "mediatek, VOLUME_UP-eint";
		interrupt-parent = <&pio>;
		interrupts = <59 IRQ_TYPE_EDGE_FALLING 59 0>;
		debounce = <32000>;
		status = "okay";
	};

	kpd_volume_down:kpd_volume_down {
		compatible = "mediatek, VOLUME_DOWN-eint";
		interrupt-parent = <&pio>;
		interrupts = <60 IRQ_TYPE_EDGE_FALLING 60 0>;
		debounce = <32000>;
		status = "okay";
	};
/*VENDOR_EDIT keypad end*/

//#ifdef VENDOR_EDIT
/*Fei.Mo@PSW.BSP.Sensor, 2017/12/18, Add for sensor calibration paramaters */
	oppo_sensor:oppo_sensor {
	};
//#endif /*VENDOR_EDIT*/
/*Bin.Li@EXP.BSP.bootloader.bootflow, 2017/05/15, Add for oppo project */
	oppo_project:oppo_project {
		compatible = "oppo,oppo_project";
	};

	oppo_devinfo:oppo_devinfo {
		compatible = "oppo, device_info";
	};
/* wen.luo@PSW.BSP.kernel, 2019/6/25, Add for parsar powoff/powon */
	oppo_lastpmic:oppo_lastpmic {
	};
//#endif /*VENDOR_EDIT*
};

/*VENDOR_EDIT*/
/*Bin.Li@EXP.BSP.bootloader.bootflow, 2017/05/16, Add volume up and down*/
&keypad {
	keypad,volume-up	= <&pio 20 0x00>;
	keypad,volume-down	= <&pio 60 0x00>;
	pinctrl-names = "volume_up_as_int", "volume_down_as_int";
	pinctrl-0 = <&volume_up_gpio_eint>;
	pinctrl-1 = <&volume_down_gpio_eint>;
	status = "okay";
};

&pio {
	volume_up_gpio_eint:volume_up@0{
		pins_cmd_dat {
			pinmux = <PINMUX_GPIO59__FUNC_GPIO59>;
			slew-rate = <0>;  /*direction 0:in, 1:out*/
			input-enable;
		};
	};

	volume_down_gpio_eint:volume_down@0{
		pins_cmd_dat {
			pinmux = <PINMUX_GPIO60__FUNC_GPIO60>;
			slew-rate = <0>;  /*direction 0:in, 1:out*/
			input-enable;
		};
	};
};
/*VENDOR_EDIT*/

/*VENDOR_EDIT Devinfo start*/
/*xing.xiong@BSP.Kernel.Debug, 2018/11/15, Add for oppo project & devinfo*/
&oppo_devinfo {
	Hw,sub_hwid_1 = <&pio 23 0x00>;
	Hw,sub_hwid_2 = <&pio 22 0x00>;
	pinctrl-names = "default", "hw_sub_id_sleep", "hw_sub_id_active";
	pinctrl-0 = <&hw_pins_default>;
	pinctrl-1 = <&hw_pins_sub_id1_sleep &hw_pins_sub_id2_sleep>;
	pinctrl-2 = <&hw_pins_sub_id1_active &hw_pins_sub_id2_active>;
};

&pio {
	hw_pins_default:default@hw_sub_id {
	};

	hw_pins_sub_id1_sleep:sleep@id1 {
			pins_cmd_dat {
				pinmux = <PINMUX_GPIO23__FUNC_GPIO23>;
				slew-rate = <0>;
				bias-pull-down = <00>;
				input-enable;
			};
	};

	hw_pins_sub_id2_sleep:sleep@id2 {
			pins_cmd_dat {
				pinmux = <PINMUX_GPIO22__FUNC_GPIO22>;
				bias-pull-down = <00>;
				input-enable;
			};
	};

	hw_pins_sub_id1_active:active@id1 {
		pins_cmd_dat {
			pinmux = <PINMUX_GPIO23__FUNC_GPIO23>;
			slew-rate = <0>;
			bias-pull-up = <00>;
			input-enable;
		};
	};
	hw_pins_sub_id2_active:active@id2 {
		pins_cmd_dat {
			pinmux = <PINMUX_GPIO22__FUNC_GPIO22>;
			slew-rate = <0>;
			bias-pull-up = <00>;
			input-enable;
		};
	};
};
/*VENDOR_EDIT*/
/*VENDOR_EDIT motor start*/
/*Guangyan.Hong@PSW.BSP.Sensor 2019-12-19, Add for motor direction switch */
&pio {
    boost: boost {
        pins_cmd_dat {
            pinmux = <PINMUX_GPIO57__FUNC_GPIO57>;
            slew-rate = <1>;
            bias-pull-down; //pull down
            output-low; //digital output, no invert
            drive-strength = <2>;//0.15
        };
    };

    pwm_config: pwm_config {
        pins_cmd_dat {
            pinmux = <PINMUX_GPIO26__FUNC_PWM_0>;
            slew-rate = <1>;
            bias-disable;
            drive-strength = <0>;
        };
    };

    pwm_config_as_gpio: pwm_config_as_gpio {
        pins_cmd_dat {
            pinmux = <PINMUX_GPIO26__FUNC_GPIO26>;
            slew-rate = <1>;
            bias-disable;
            output-low;
            drive-strength = <0>; //LOW strength
        };
    };

    enable_gpio: enable_gpio {
        pins_cmd_dat {
            pinmux = <PINMUX_GPIO34__FUNC_GPIO34>;
            slew-rate = <1>;
            bias-disable; //No Pull
            output-low;
            drive-strength = <0>; //LOW strength
        };
    };

    dir_gpio: dir_gpio {
        pins_cmd_dat {
            pinmux = <PINMUX_GPIO33__FUNC_GPIO33>;
            slew-rate = <1>;
            bias-disable;
            output-low;
            drive-strength = <0>; /* LOW strength */
        };
    };

    standby_gpio: standby_gpio {
        pins_cmd_dat {
            pinmux = <PINMUX_GPIO30__FUNC_GPIO30>;
            slew-rate = <1>;
            bias-disable;
            output-low; /* digital output, no invert */
            drive-strength = <0>; /* LOW strength */
        };
    };

    mode1_gpio: mode1_gpio {
        pins_cmd_dat {
            pinmux = <PINMUX_GPIO149__FUNC_GPIO149>;
            slew-rate = <1>;
            bias-disable;
            output-low;
            drive-strength = <0>; /* LOW strength */
        };
    };
};

&motor_pl {
        status = "okay";
        compatible = "oppo-motor";
        hall-irq-pos = <170>;
	motor-retard-pos = <430>;
        delay-cycle = <25 14 20>; //ms
        slow-delay-cycle = <28 28 28>; //ms
        full-speed-param = <55 13500>;
        up-speed-param = <5 13500>;
        down-speed-param = <3 156250>;
        nodetect-speed-param = <15 13500>;
        slow-full-speed-param = <60 31250>;
        slow-up-speed-param = <5 104166>;
        slow-down-speed-param = <3 156250>;
        slow-nodetect-speed-param = <15 104166>;
        stop-neg-point = <2 2>;
        stop-pos-point = <2 2>;
        terminal-offset = <25 25>;
        offset-stop-retry = <2>;
	//pos-change-thrd = <300 350>;
	hall-data-sign = <0>;//1 represent positive ,0 represent negative
	press-irq-makeup = <55 55>;
	stop-retry = <4>;
	//motor_stop_val_support;
	//motor_stop_val = <2 1>;
	motor_down_stop_support;
	motor_down_stop_val = <1>;
	cal_stop_val = <1 1>;
	full_stop_val = <3 50>;
	cal_fix_stop_retry_support;
	cal_fix_stop_retry = <4>;
	motor_retard_offset_support;
	//motor_modify_stopcount_support;
	motor_small_irq_later_speed_down_support;
	small-irq-later-speed-down = <400 15 10>;
	/*
	support mag noise decrease:
	511 - pattern[0] = irq_max
	pattern[1] - 512 = irq_min
	511 - pattern[2] = normal_max
	pattern[3] - 512 = normal_min
	average = 200
	*/
	mag_noise_support;
	mag_noise_pattern = <80 400 0 662 200 100 100>;
};

&motor_drv {
        status = "okay";
        compatible = "motor_drv-220";
        pinctrl-names = "boost","pwm_config","pwm_config_as_gpio","enable_gpio","dir_gpio","standby_gpio","mode1_gpio";
        pinctrl-0 = <&boost>;
        pinctrl-1 = <&pwm_config>;
        pinctrl-2 = <&pwm_config_as_gpio>;
        pinctrl-3 = <&enable_gpio>;
        pinctrl-4 = <&dir_gpio>;
        pinctrl-5 = <&standby_gpio>;
        pinctrl-6 = <&mode1_gpio>;
        boost-gpio = <&pio 57 0x00>;
        standby-gpio = <&pio 30 0>;
        dir-gpio = <&pio 33 0>;
        enable-gpio =  <&pio 34 0>;
        step-gpio = <&pio 26 0>;
        mode1-gpio = <&pio 149 0>;
        ratio-a = <24>;
        ratio-b = <1840>;//18.40
        ratio-c = <20>;
        ratio-d = <32>;
};

&i2c3 {
    dhall0-m1120@0f {
        status = "okay";
        compatible = "oppo,dhall-m1120";
        reg = <0x0f>;
        //pinctrl-names = "hall_power_down","hall_power_up","hall0_interrupt_input";
        pinctrl-names = "hall0_interrupt_input";
        //pinctrl-0 = <&hall_power_down>;
        //pinctrl-1 = <&hall_power_up>;
        //pinctrl-2 = <&hall0_interrupt_input>;
        pinctrl-0 = <&hall0_interrupt_input>;
        interrupt-parent = <&pio>;
        interrupts = <32 IRQ_TYPE_LEVEL_LOW 32 0>;
        dhall,irq-gpio = <&pio 32 0x2008>;
        dhall,id = <0>;
        vdd_2v8-supply = <&mt_pmic_vio28_ldo_reg>;//VREG_3P0
        vcc_1v8-supply = <&mt_pmic_vio18_ldo_reg>;//VREG_1P8
        //hall-power-gpio = <&pio 155 0>;
	hall,bias_support;
	hall,bias-ratio = <80>;// current/goal *100
        };

    dhall1-m1120@0c {
        status = "okay";
        compatible = "oppo,dhall-m1120";
        reg = <0x0c>;
        //pinctrl-names = "hall_power_down","hall_power_up","hall1_interrupt_input";
        pinctrl-names = "hall1_interrupt_input";
        //pinctrl-0 = <&hall_power_down>;
        //pinctrl-1 = <&hall_power_up>;
        //pinctrl-2 = <&hall1_interrupt_input>;
        pinctrl-0 = <&hall1_interrupt_input>;
        interrupt-parent = <&pio>;
        interrupts = <31 IRQ_TYPE_LEVEL_LOW 31 0>;
        dhall,irq-gpio = <&pio 31 0x2008>;
        dhall,id = <1>;
        vdd_2v8-supply = <&mt_pmic_vio28_ldo_reg>;//VREG_3P0
        vcc_1v8-supply = <&mt_pmic_vio18_ldo_reg>;//VREG_1P8
        //hall-power-gpio = <&pio 155 0>;
	hall,bias_support;
	hall,bias-ratio = <80>;// current/goal *100
        };
	dhall0-ist8801@1b {
		status = "okay";
		compatible = "oppo,dhall-ist8801";
		reg = <0x1b>;
		//pinctrl-names = "hall_power_down","hall_power_up","hall0_interrupt_input";
		pinctrl-names = "hall0_interrupt_input";
		//pinctrl-0 = <&hall_power_down>;
		//pinctrl-1 = <&hall_power_up>;
		//pinctrl-2 = <&hall0_interrupt_input>;
		pinctrl-0 = <&hall0_interrupt_input>;
		interrupt-parent = <&pio>;
		interrupts = <32 IRQ_TYPE_LEVEL_LOW 32 0>;
		dhall,irq-gpio = <&pio 32 0x2008>;
		dhall,id = <0>;
		vdd_2v8-supply = <&mt_pmic_vio28_ldo_reg>;//VREG_3P0
		vcc_1v8-supply = <&mt_pmic_vio18_ldo_reg>;//VREG_1P8
		//hall-power-gpio = <&pio 110 0>;
		hall,bias_support;
		hall,bias-ratio = <80>;// current/goal *100
	};

	dhall1-ist8801@18 {
		status = "okay";
		compatible = "oppo,dhall-ist8801";
		reg = <0x18>;
		//pinctrl-names = "hall_power_down","hall_power_up","hall1_interrupt_input";
		pinctrl-names = "hall1_interrupt_input";
		//pinctrl-0 = <&hall_power_down>;
		//pinctrl-1 = <&hall_power_up>;
		//pinctrl-2 = <&hall1_interrupt_input>;
		pinctrl-0 = <&hall1_interrupt_input>;
		interrupt-parent = <&pio>;
		interrupts = <31 IRQ_TYPE_LEVEL_LOW 31 0>;
		dhall,irq-gpio = <&pio 31 0x2008>;
		dhall,id = <1>;
		vdd_2v8-supply = <&mt_pmic_vio28_ldo_reg>;//VREG_3P0
		vcc_1v8-supply = <&mt_pmic_vio18_ldo_reg>;//VREG_1P8
		//hall-power-gpio = <&pio 110 0>;
		hall,bias_support;
		hall,bias-ratio = <80>;// current/goal *100
	};
};

&pio {
    /*hall_power_up: hall_power_up {
        pins_cmd_dat {
            pinmux = <PINMUX_GPIO155__FUNC_GPIO155>;
            slew-rate = <1>;
            drive-strength = <2>;
            output-high;
            bias-pull-down;
            };
    };
    hall_power_down: hall_power_down {
        pins_cmd_dat {
            pinmux = <PINMUX_GPIO155__FUNC_GPIO155>;
            slew-rate = <1>;
            drive-strength = <2>;
            output-low;
            bias-pull-down;
        };
    };*/
    hall0_interrupt_input: hall0_interrupt_input {
        pins_cmd_dat {
            pinmux = <PINMUX_GPIO32__FUNC_GPIO32>;
            slew-rate = <0>;
            drive-strength = <2>;
            bias-disable; //No Pull
        };
    };
    hall1_interrupt_input: hall1_interrupt_input {
        pins_cmd_dat {
            pinmux = <PINMUX_GPIO31__FUNC_GPIO31>;
            slew-rate = <0>;
            drive-strength = <2>;
            bias-disable; //No Pull
        };
    };
};
/*motor end*/

//#ifdef VENDOR_EDIT
/* hongxiang.jin@PSW.MM.AudioDriver.Machine, 2019/09/19,
 * Modify for tfa I2C & gpio config */
&i2c6 {

    tfa98xx@35 {
        compatible = "nxp,tfa98xx";
        reg = <0x35>;
        audio_mic_mode = <2>;
        headset_mic_mode = <2>;
        soundtrigger_enable = <0>;
        speaker_type = <2>;
        status = "okay";
        oppo,tfa98xx-dual-spk = <0>;
        pinctrl-names = "tfa98xx_reset_default", "tfa98xx_reset_high", "tfa98xx_reset_low";
        pinctrl-0 = <&tfa98xxresetdefault>;
        pinctrl-1 = <&tfa98xxresethigh>;
        pinctrl-2 = <&tfa98xxresetlow>;
    };
};

&pio {
	tfa98xxresetdefault: tfa98xxrstdefault {
	};

	tfa98xxresethigh: tfa98xxrsthigh {
		pins_cmd_dat {
			pinmux = <PINMUX_GPIO141__FUNC_GPIO141>;
			slew-rate = <1>;
			output-high;
		};
	};

	tfa98xxresetlow: tfa98xxrstlow {
		pins_cmd_dat {
			pinmux = <PINMUX_GPIO141__FUNC_GPIO141>;
			slew-rate = <1>;
			output-low;
		};
	};
};
&snd_audio_dsp {
	compatible = "mediatek,snd_audio_dsp";
	mtk_dsp_voip = <0x1 0x1 0xffffffff 0xffffffff>;
	mtk_dsp_primary = <0x0 0x0 0xffffffff 0xffffffff>;
	mtk_dsp_offload = <0x0 0x6 0xffffffff 0xffffffff>;
	mtk_dsp_deep = <0x0 0x3 0xffffffff 0xffffffff>;
	//#ifdef VENDOR_EDIT
	//Yongzhi.Zhang@PSW.MM.AudioDriver.Feature.1209435, 2019/03/09, add for P90 KTV
	mtk_dsp_playback = <0x1 0x4 0xf 0xffffffff>;
	//#else /* VENDOR_EDIT */
	//mtk_dsp_playback = <0x0 0x4 0xf 0xffffffff>;
	//#endif /* VENDOR_EDIT */
	mtk_dsp_capture1 = <0x1 0xffffffff 0xc 0x12>;
	mtk_dsp_a2dp = <0x0 0xffffffff 0xffffffff 0xffffffff>;
	mtk_dsp_dataprovider = <0x0 0xffffffff 0xf 0xffffffff>;
	mtk_dsp_call_final = <0x0 0x4 0xf 0x13>;
	mtk_dsp_ktv = <0x0 0x8 0x11 0xffffffff>;
	swdsp_smartpa_process_enable = <0x0>;
};
//#endif /* VENDOR_EDIT */

/* TOUCH start */
/* #ifndef VENDOR_EDIT */
/* ZhongWenjie@BSP.TP.FUNC, 2017/11/07, Add for tp driver */
/*
&touch {
	tpd-resolution = <1080 2160>;
	use-tpd-button = <0>;
	tpd-key-num = <3>;
	tpd-key-local= <139 172 158 0>;
	tpd-key-dim-local = <90 883 100 40 230
				883 100 40 370 883 100 40 0 0 0 0>;
	tpd-max-touch-num = <10>;
	tpd-filter-enable = <1>;
	tpd-filter-pixel-density = <168>;
	tpd-filter-custom-prameters = <0 0 0 0 0 0 0 0 0 0 0 0>;
	tpd-filter-custom-speed = <0 0 0>;
	pinctrl-names = "default", "state_eint_as_int", "state_eint_output0",
		"state_eint_output1", "state_rst_output0", "state_rst_output1";
	pinctrl-0 = <&ctp_pins_default>;
	pinctrl-1 = <&ctp_pins_eint_as_int>;
	pinctrl-2 = <&ctp_pins_eint_output0>;
	pinctrl-3 = <&ctp_pins_eint_output1>;
	pinctrl-4 = <&ctp_pins_rst_output0>;
	pinctrl-5 = <&ctp_pins_rst_output1>;
	status = "okay";
};
&pio {
	ctp_pins_default: eint0default {
	};
	ctp_pins_eint_as_int: eint@0 {
		pins_cmd_dat {
			pinmux = <PINMUX_GPIO1__FUNC_GPIO1>;
			slew-rate = <0>;
			bias-disable;
		};
	};
	ctp_pins_eint_output0: eintoutput0 {
		pins_cmd_dat {
			pinmux = <PINMUX_GPIO1__FUNC_GPIO1>;
			slew-rate = <1>;
			output-low;
		};
	};
	ctp_pins_eint_output1: eintoutput1 {
		pins_cmd_dat {
			pinmux = <PINMUX_GPIO1__FUNC_GPIO1>;
			slew-rate = <1>;
			output-high;
	};
	};
	ctp_pins_rst_output0: rstoutput0 {
		pins_cmd_dat {
			pinmux = <PINMUX_GPIO2__FUNC_GPIO2>;
			slew-rate = <1>;
			output-low;
		};
	};
	ctp_pins_rst_output1: rstoutput1 {
		pins_cmd_dat {
			pinmux = <PINMUX_GPIO2__FUNC_GPIO2>;
			slew-rate = <1>;
			output-high;
		};
	};
};
*/
/* TOUCH end */
/* #else */
/* &spi7 {
	 Novatek device tree node */
/*	status = "ok";
	#address-cells = <1>;
	#size-cells = <0>;
	touchscreen@0 {
		status = "okay";
		compatible = "oppo,tp_noflash";
		reg = <0>;
		chip-name = "OPPO_TP_NOFLASH";

		spi-max-frequency = <9600000>;	//4800000,9600000,15000000,19200000
		reset-gpio = <&pio 58 0x00>;
		interrupt-parent = <&pio>;
		interrupts = <1 IRQ_TYPE_LEVEL_LOW 1 0>;
		irq-gpio = <&pio 1 0x2008>;
  
               synaptics,irq-on-state = <0>;
               synaptics,reset-on-state = <0>;
               synaptics,reset-active-ms = <20>;
               synaptics,reset-delay-ms = <200>;
               synaptics,power-delay-ms = <200>;
               synaptics,spi-mode = <3>;
               synaptics,byte-delay-us = <0>;
               synaptics,block-delay-us = <0>;
               synaptics,ubl-max-freq = <1000000>;
               synaptics,ubl-byte-delay-us = <20>;
		
		touchpanel,max-num-support = <10>;
		touchpanel,tx-rx-num = <16 36>;
		touchpanel,panel-coords = <1080 2340>;
		touchpanel,display-coords = <1080 2340>;

                incell_screen;
                fw_edge_limit_support;
                black_gesture_support;
                charger_pump_support;
                headset_pump_support;
                //spurious_fingerprint_support;
                //lcd_trigger_fp_check;
                black_gesture_test_support;
                game_switch_support;
                noflash_support;
                lcd_trigger_load_tp_fw_support;
                smart_gesture_support;
                fw_update_app_support;
                pressure_report_support;
                freq_hop_simulate_support;

		*Virtual Key Config:
		*1:touchpanel,button-type: <virtualkey_type  supportted_button-map>
		*virtualkey_type:
		*Type 1: using board_properties
		*Type 2: using same IC (button zone&& touch zone are seprate)
		*Type 3: using diffrent IC (button zone&& touch zone are seprate)
		*Type 4: No need of virtual key process
		*supportted_button-map:select|menu|home|back
		*
		*2:touchpanel,button-map
		*type (X1,Y1)(X2,Y2)(X3,Y3)(Width_X,Hight_Y)--Only when button-type is 0
		*/

/*		touchpanel,button-type = <4>;
	};
};*/
/* #endif VENDOR_EDIT */

//#ifdef VENDOR_EDIT
&i2c0 {
	//wangkun@BSP.group 2019-01-02 add for enable i2c_0
	status = "okay";
	synaptics19301@20 {
		compatible = "synaptics-s3706";
		reg = <0x20>;
		chip-name = "S3706";

		/* Interrupt && Irq-gpio */
		//interrupt-parent = <&tlmm>;
		//interrupts = <1 0x2008>;
		interrupt-parent = <&pio>;
		interrupts = <1 IRQ_TYPE_LEVEL_LOW 1 0>;

		/* Power Config */
		enable2v8_gpio = <&pio 4 0x1>;
		//vdd_2v8-supply = <&mt_pmic_vmch_ldo_reg>;
		//vcc_1v8-supply = <&pm660_l14>;
		//vdd_2v8_volt = <2950000>;

		/* Other HW Resource */
		//irq-gpio = <&tlmm 1 0x2008>;
		irq-gpio = <&pio 1 0x2008>;
		//reset-gpio = <&tlmm 58 0x1>;
		reset-gpio = <&pio 58 0>;
		pinctrl-names = "default";
		//pinctrl-0 = <&ts_int_active &ts_reset_active>;

		touchpanel,max-num-support = <10>;
		touchpanel,tx-rx-num = <16 34>;
		touchpanel,panel-coords = <1080 2340>;
		touchpanel,display-coords = <1080 2340>;
		touchpanel,touchmajor-limit = <0 54>;

		/* SW Support Feature Control */
		black_gesture_support;
		fw_edge_limit_support;
		fw_corner_limit_support;
		pressure_report_support;
		//spurious_fingerprint_support;
		charger_pump_support;
		game_switch_support;
		face_detect_support;
		smart_gesture_support;
		fw_update_app_support;
		fingerprint_underscreen_support;
		//rt155_fdreplace_rt59_support;
		report_120hz_support;
		report_point_first_support;
		/*
		 *Virtual Key Config:
		 *1:touchpanel,button-type: <virtualkey_type  supportted_button-map>
		 *virtualkey_type:
		 *Type 1: using board_properties
		 *Type 2: using same IC (button zone&& touch zone are seprate)
		 *Type 3: using diffrent IC (button zone&& touch zone are seprate)
		 *Type 4: No need of virtual key process
		 *supportted_button-map:select|menu|home|back
		 *
		 *2:touchpanel,button-map
		 *type (X1,Y1)(X2,Y2)(X3,Y3)(Width_X,Hight_Y)--Only when button-type is 0
		 */
		touchpanel,button-type = <4>;
		touchpanel.button-TRx = <0 0>;
	};
};
//#endif

//#ifdef VENDOR_EDIT
/* Bin.Li@BSP.Fingerprint.Secure, 2019/05/20, Add for breathing light */
&i2c2 {
	led-ktd2026@30{
		status = "okay";
		compatible = "oppo,ktd2026";
		vdd_1v8-supply = <&mt_pmic_vcamio_ldo_reg>;
		reg = <0x30 0>;
		ktd2026,id = <0>;
	};

	aw2026@64 {
		    status = "okay";
			compatible = "aw,aw2026";
			reg = <0x64>;
			vdd_1v8-supply = <&mt_pmic_vcamio_ldo_reg>;
			aw2026,max_current = <0x03>; //25.5mA
			aw2026,max_brightness = <0x30>;  //current: 48/255 *3.1875 = 0.6mA
			aw2026,id = <0>;
	};
};

&i2c4 {
	led-ktd2026@30{
		status = "okay";
		compatible = "oppo,ktd2026";
		reg = <0x30 0>;
		vdd_1v8-supply = <&mt_pmic_vcamio_ldo_reg>;
		ktd2026,id = <1>;
	};

	aw2026@64 {
		    status = "okay";
			compatible = "aw,aw2026";
			reg = <0x64>;
			vdd_1v8-supply = <&mt_pmic_vcamio_ldo_reg>;
			aw2026,max_current = <0x03>; //25.5mA
			aw2026,max_brightness = <0x30>;  //current: 48/255 *3.1875 = 0.6mA
			aw2026,id = <1>;
	};
};
//#endif

/* IRTX GPIO end */
&irtx_pwm {
	pinctrl-names = "irtx_gpio_led_default", "irtx_gpio_led_set";
	pinctrl-0 = <&irtx_gpio_led_default>;
	pinctrl-1 = <&irtx_gpio_led_set>;
	status = "okay";
};
&pio {
	irtx_gpio_led_default:irtx_gpio_led_def@gpio26 {
		pins_cmd_dat {
			pinmux = <PINMUX_GPIO26__FUNC_GPIO26>;
			slew-rate = <1>;
			bias-disable;
			output-low;
			input-schmitt-enable = <0>;
		};
	};

	irtx_gpio_led_set:irtx_gpio_led_set@gpio26 {
		pins_cmd_dat {
			pinmux = <PINMUX_GPIO26__FUNC_PWM_0>;
			slew-rate = <1>;
			output-high;
		};
	};
};
/* IRTX GPIO Settings -End */

/* DISPSYS GPIO standardization */
/* #ifndef VENDOR_EDIT */
/* Yongpeng.Yi@PSW.MM.Display.LCD.Machine, 2017/11/03, Add for lcd driver */
/*
&pio {
	mtkfb_pins_lcd_bias_enp1: lcd_bias_enp1_gpio {
		pins_cmd_dat {
			pinmux = <PINMUX_GPIO23__FUNC_GPIO23>;
			slew-rate = <1>;
			output-high;
		};
	};

	mtkfb_pins_lcd_bias_enp0: lcd_bias_enp0_gpio {
		pins_cmd_dat {
			pinmux = <PINMUX_GPIO23__FUNC_GPIO23>;
			slew-rate = <1>;
			output-low;
		};
	};

	mtkfb_pins_lcd_bias_enn1: lcd_bias_enn1_gpio {
		pins_cmd_dat {
			pinmux = <PINMUX_GPIO202__FUNC_GPIO202>;
			slew-rate = <1>;
			output-high;
		};
	};

	mtkfb_pins_lcd_bias_enn0: lcd_bias_enn0_gpio {
		pins_cmd_dat {
			pinmux = <PINMUX_GPIO202__FUNC_GPIO202>;
			slew-rate = <1>;
			output-low;
		};
	};
};

&mtkfb {
	pinctrl-names = "lcd_bias_enp1_gpio", "lcd_bias_enp0_gpio",
		"lcd_bias_enn1_gpio", "lcd_bias_enn0_gpio";
	pinctrl-0 = <&mtkfb_pins_lcd_bias_enp1>;
	pinctrl-1 = <&mtkfb_pins_lcd_bias_enp0>;
	pinctrl-2 = <&mtkfb_pins_lcd_bias_enn1>;
	pinctrl-3 = <&mtkfb_pins_lcd_bias_enn0>;
	status = "okay";
};
*/

/* #else */

&pio {

	mtkfb_pins_mode_te_gpio: mode_te_gpio {
		pins_cmd_dat {
			pinmux = <PINMUX_GPIO43__FUNC_GPIO43>;
	};
		};

	mtkfb_pins_mode_te_te: mode_te_te {
		pins_cmd_dat {
			pinmux = <PINMUX_GPIO43__FUNC_DSI_TE>;
		};
};

	mtkfb_pins_lcm_reset0: lcm_rst_out0_gpio {
		pins_cmd_dat {
			pinmux = <PINMUX_GPIO44__FUNC_GPIO44>;
			slew-rate = <1>;
			output-low;
		};
};

	mtkfb_pins_lcm_reset1: lcm_rst_out1_gpio {
		pins_cmd_dat {
			pinmux = <PINMUX_GPIO44__FUNC_GPIO44>;
			slew-rate = <1>;
			output-high;
		};
};

	mtkfb_pins_lcd_vci_en0: lcd_vci_en0_gpio {
		pins_cmd_dat {
			pinmux = <PINMUX_GPIO5__FUNC_GPIO5>;
			slew-rate = <1>;
			output-low;
		};
	};

	mtkfb_pins_lcd_vci_en1: lcd_vci_en1_gpio {
		pins_cmd_dat {
			pinmux = <PINMUX_GPIO5__FUNC_GPIO5>;
			slew-rate = <1>;
			output-high;
		};
	};

	mtkfb_pins_lcd_mipi_err_en0: lcd_mipi_err_en0_gpio {
		pins_cmd_dat {
			pinmux = <PINMUX_GPIO7__FUNC_GPIO7>;
			slew-rate = <1>;
			output-low;
		};
	};

	mtkfb_pins_lcd_mipi_err_en1: lcd_mipi_err_en1_gpio {
		pins_cmd_dat {
			pinmux = <PINMUX_GPIO7__FUNC_GPIO7>;
			slew-rate = <1>;
			output-high;
		};
	};

	mtkfb_pins_default: default {
};
};

&mtkfb {
	pinctrl-names = "default", "mode_te_gpio", "mode_te_te", "lcm_rst_out0_gpio",
	"lcm_rst_out1_gpio", "lcd_vci_en0_gpio", "lcd_vci_en1_gpio",
	"lcd_mipi_err_en0_gpio", "lcd_mipi_err_en1_gpio";
	pinctrl-0 = <&mtkfb_pins_default>;
	pinctrl-1 = <&mtkfb_pins_mode_te_gpio>;
	pinctrl-2 = <&mtkfb_pins_mode_te_te>;
	pinctrl-3 = <&mtkfb_pins_lcm_reset0>;
	pinctrl-4 = <&mtkfb_pins_lcm_reset1>;
	pinctrl-5 = <&mtkfb_pins_lcd_vci_en0>;
	pinctrl-6 = <&mtkfb_pins_lcd_vci_en1>;
	pinctrl-7 = <&mtkfb_pins_lcd_mipi_err_en0>;
	pinctrl-8 = <&mtkfb_pins_lcd_mipi_err_en1>;
	status = "okay";
	oppo_display_hbm_support;
	oppo_display_ffl_support;
	oppo_display_panelid_support;
	oppo_display_panelnum_support;
	oppo_display_sau_support;
	oppo_display_fppress_support;
	oppo_display_aodlight_support;
	oppo_display_tenbits_support;
};

/* #endif VENDOR_EDIT */

/* DISPSYS GPIO standardization end */

/* accdet start */
&accdet {
	/* accdet micbias voltage: 0x09:2.85v 0x08:2.8v 0x07,
	 * 2.7v;0x05,2.5v;0x02,1.9v
	 */
	accdet-mic-vol = <8>;
	/* accdet pwm_width, pwm_thresh, fall_delay, rise_delay
	 * debounce0, debounce1, debounce3, debounce4
	 * eint pwm_width, eint pwm_thresh
	 * eint deb(debounce0, debounce1, debounce2, debounce3), inv_debounce
	 */
	headset-mode-setting = <0x500 0x500 1 0x1f0
				0x2000 0x800 0x2000 0x44
				0x0 0x7
				0x5 0x9 0x9 0xd 0xe>;
	accdet-plugout-debounce = <1>;
	/*1:ACC mode, 2:low cost without in bias, 6:low cost with in bias*/
	accdet-mic-mode = <2>;
	/*0--MD_MAX--UP_MAX--DW_MAX*/

	//#ifdef VENDOR_EDIT
	//Yongzhi.Zhang@PSW.MM.AudioDriver.HeadsetDet, 2018/01/22, Modify for support headset key
	headset-three-key-threshold = <0 82 170 306>;
	//#else /* VENDOR_EDIT */
	//headset-three-key-threshold = <0 80 220 400>;
	//#endif /* VENDOR_EDIT */
	headset-three-key-threshold-CDD = <0 121 192 600>;
	/*0--MD_MAX--VOICE_MAX--UP_MAX--DW_MAX*/
	headset-four-key-threshold = <0 58 121 192 400>;

//#ifdef VENDOR_EDIT
//Yongzhi.Zhang@PSW.MM.AudioDriver.HeadsetDet, 2019/01/01, add for moisture detection
	/* moisture HW mode config start. Enable moisture detection or not
	 * default use HW mode for moisture detection
	 */
	moisture_detect_enable = <1>;
//#endif /* VENDOR_EDIT */
	/* select VTH to 2v and 500k, use internal resitance */
	eint_use_ext_res = <0>;
//#ifdef VENDOR_EDIT
//Yongzhi.Zhang@PSW.MM.AudioDriver.HeadsetDet, 2019/01/01, add for moisture detection
	/* enable eint detection mode, if moisture detection enable
	 * eint_detect_mode = moisture_detect_mode;otherwise, select
	 * eint_detect_mode = 4 as DEFAULT
	 */
	eint_detect_mode = <5>;
	/* enable moisture detection mode, if moisture detection enable
	 * eint_detect_mode = moisture_detect_mode
	 */
	moisture_detect_mode = <5>;
	/* select 0: 2.8V; 1: 2.4V; 2: 2V; 3: VTH=MVTH(VTH2) */
	moisture_comp_vth = <2>;
	/* vref2 voltage for different water impedance */
	moisture_comp_vref2 = <0>;
	/* moisture HW mode config end */

	/* moisture SW mode config start, use external resister or not.
	 * DEFAULT NOT NEED
	 */
	moisture_use_ext_res = <0>;
	/* moisture external resister ohm, SW mode by auxadc */
	moisture-external-r = <2000000>;
	/* moisture internal resister ohm, SW mode by auxadc */
	moisture-internal-r = <47000>;
	/* moisture of water resister ohm, SW mode by auxadc*/
	moisture-water-r = <10000>;
	/* moisture SW mode config end */
//#endif /* VENDOR_EDIT */
	/* ACCDET GPIO standardization for AP EINT */
	pinctrl-names = "default", "state_eint_as_int";
	pinctrl-0 = <&accdet_pins_default>;
	pinctrl-1 = <&accdet_pins_eint_as_int>;
	status = "okay";
};
&pio {
	accdet_pins_default: accdetdefault {
	};
	accdet_pins_eint_as_int: accdeteint@0 {
		pins_cmd_dat {
			pinmux = <PINMUX_GPIO9__FUNC_GPIO9>;
			slew-rate = <0>;
			bias-disable;
		};
	};
};
/* accdet end */
/* CAMERA GPIO standardization */
/*Henry.Chang@Camera.Driver, 2018/11/08, Modify for Camera*/
&kd_camera_hw1 {
     vcamaf-supply = <&mt_pmic_vtp_ldo_reg>;
     status = "okay";
};

&pio {
	camera0_rst_low: camera0_rst_output_low@gpio119 {
		pins_cmd_dat {
			pinmux = <PINMUX_GPIO119__FUNC_GPIO119>;
			output-low;
		};
	};
	camera0_rst_high: camera0_rst_output_high@gpio119 {
		pins_cmd_dat {
			pinmux = <PINMUX_GPIO119__FUNC_GPIO119>;
			output-high;
		};
	};
	camera1_rst_low: camera1_rst_output_low@gpio124 {
		pins_cmd_dat {
			pinmux = <PINMUX_GPIO124__FUNC_GPIO124>;
			output-low;
		};
	};
	camera1_rst_high: camera1_rst_output_high@gpio124 {
		pins_cmd_dat {
			pinmux = <PINMUX_GPIO124__FUNC_GPIO124>;
			output-high;
		};
	};
	camera2_rst_low: camera2_rst_output_low@gpio118 {
		pins_cmd_dat {
			pinmux = <PINMUX_GPIO118__FUNC_GPIO118>;
			output-low;
		};
	};
	camera2_rst_high: camera2_rst_output_high@gpio118 {
		pins_cmd_dat {
			pinmux = <PINMUX_GPIO118__FUNC_GPIO118>;
			output-high;
		};
	};
	/* Feiping.Li@Camera.Driver, 2019/05/22, Add for 19301 rear 4 sensor */
	camera3_rst_low: camera3_rst_output_low@gpio123 {
		pins_cmd_dat {
			pinmux = <PINMUX_GPIO123__FUNC_GPIO123>;
			output-low;
		};
	};
	camera3_rst_high: camera3_rst_output_high@gpio123 {
		pins_cmd_dat {
			pinmux = <PINMUX_GPIO123__FUNC_GPIO123>;
			output-high;
		};
	};
	camera4_rst_low: camera4_rst_output_low@gpio125 {
		pins_cmd_dat {
			pinmux = <PINMUX_GPIO125__FUNC_GPIO125>;
			output-low;
		};
	};
	camera4_rst_high: camera4_rst_output_high@gpio125 {
		pins_cmd_dat {
			pinmux = <PINMUX_GPIO125__FUNC_GPIO125>;
			output-high;
		};
	};
	camera0_vcama_off: camera0_vcama_output_low@gpio148 {
		pins_cmd_dat {
			pinmux = <PINMUX_GPIO148__FUNC_GPIO148>;
			output-low;
		};
	};
	camera0_vcama_on: camera0_vcama_output_high@gpio148 {
		pins_cmd_dat {
			pinmux = <PINMUX_GPIO148__FUNC_GPIO148>;
			output-high;
		};
	};
	camera0_vcama1_off: camera0_vcama1_output_low@gpio114 {
		pins_cmd_dat {
			pinmux = <PINMUX_GPIO114__FUNC_GPIO114>;
			output-low;
		};
	};
	camera0_vcama1_on: camera0_vcama1_output_high@gpio114 {
		pins_cmd_dat {
			pinmux = <PINMUX_GPIO114__FUNC_GPIO114>;
			output-high;
		};
	};
	camera0_vcamd_off: camera0_vcamd_output_low@gpio153 {
		pins_cmd_dat {
			pinmux = <PINMUX_GPIO153__FUNC_GPIO153>;
			slew-rate = <1>;
			output-low;
		};
	};
	camera0_vcamd_on: camera0_vcamd_output_high@gpio153 {
		pins_cmd_dat {
			pinmux = <PINMUX_GPIO153__FUNC_GPIO153>;
			output-high;
		};
	};
	camera1_vcama_off: camera1_vcama_output_low@gpio151 {
		pins_cmd_dat {
			pinmux = <PINMUX_GPIO151__FUNC_GPIO151>;
			output-low;
		};
	};
	camera1_vcama_on: camera1_vcama_output_high@gpio151 {
		pins_cmd_dat {
			pinmux = <PINMUX_GPIO151__FUNC_GPIO151>;
			output-high;
		};
	};
	camera1_vcamd_off: camera1_vcamd_output_low@gpio153 {
		pins_cmd_dat {
			pinmux = <PINMUX_GPIO153__FUNC_GPIO153>;
			slew-rate = <1>;
			output-low;
		};
	};
	camera1_vcamd_on: camera1_vcamd_output_high@gpio153 {
		pins_cmd_dat {
			pinmux = <PINMUX_GPIO153__FUNC_GPIO153>;
			output-high;
		};
	};
	camera2_vcama_off: camera2_vcama_output_low@gpio151 {
		pins_cmd_dat {
			pinmux = <PINMUX_GPIO151__FUNC_GPIO151>;
			output-low;
		};
	};
	camera2_vcama_on: camera2_vcama_output_high@gpio151 {
		pins_cmd_dat {
			pinmux = <PINMUX_GPIO151__FUNC_GPIO151>;
			output-high;
		};
	};
	camera2_vcamd_off: camera2_vcamd_output_low@gpio155 {
		pins_cmd_dat {
			pinmux = <PINMUX_GPIO155__FUNC_GPIO155>;
			output-low;
		};
	};
	camera2_vcamd_on: camera2_vcamd_output_high@gpio155 {
		pins_cmd_dat {
			pinmux = <PINMUX_GPIO155__FUNC_GPIO155>;
			output-high;
		};
	};
	/* Feiping.Li@Camera.Driver, 2019/05/22, Add for 19301 rear 4 sensor */
	camera3_vcama_off: camera3_vcama_output_low@gpio151 {
		pins_cmd_dat {
			pinmux = <PINMUX_GPIO151__FUNC_GPIO151>;
			output-low;
		};
	};
	camera3_vcama_on: camera3_vcama_output_high@gpio151 {
		pins_cmd_dat {
			pinmux = <PINMUX_GPIO151__FUNC_GPIO151>;
			output-high;
		};
	};
	camera3_vcamd_off: camera3_vcamd_output_low@gpio155 {
		pins_cmd_dat {
			pinmux = <PINMUX_GPIO155__FUNC_GPIO155>;
			slew-rate = <1>;
			output-low;
		};
	};
	camera3_vcamd_on: camera3_vcamd_output_high@gpio155 {
		pins_cmd_dat {
			pinmux = <PINMUX_GPIO155__FUNC_GPIO155>;
			output-high;
		};
	};
	camera4_vcama_off: camera4_vcama_output_low@gpio151 {
		pins_cmd_dat {
			pinmux = <PINMUX_GPIO151__FUNC_GPIO151>;
			output-low;
		};
	};
	camera4_vcama_on: camera4_vcama_output_high@gpio151 {
		pins_cmd_dat {
			pinmux = <PINMUX_GPIO151__FUNC_GPIO151>;
			output-high;
		};
	};
	camera4_vcamd_off: camera4_vcamd_output_low@gpio155 {
		pins_cmd_dat {
			pinmux = <PINMUX_GPIO155__FUNC_GPIO155>;
			output-low;
		};
	};
	camera4_vcamd_on: camera4_vcamd_output_high@gpio155 {
		pins_cmd_dat {
			pinmux = <PINMUX_GPIO155__FUNC_GPIO155>;
			output-high;
		};
	};
	camera0_mclk_off: camera0_mclk_gpio_mode@gpio117 {
		pins_cmd_dat {
			pinmux = <PINMUX_GPIO117__FUNC_GPIO117>;
			drive-strength = <1>;
		};
	};
	camera0_mclk_2mA: camera0_mclk_2mA@gpio117 {
		pins_cmd_dat {
			pinmux = <PINMUX_GPIO117__FUNC_CMMCLK1>;
			drive-strength = <MTK_DRIVE_2mA>;
		};
	};
	camera0_mclk_4mA: camera0_mclk_4mA@gpio117 {
		pins_cmd_dat {
			pinmux = <PINMUX_GPIO117__FUNC_CMMCLK1>;
			drive-strength = <MTK_DRIVE_4mA>;
		};
	};
	camera0_mclk_6mA: camera0_mclk_6mA@gpio117 {
		pins_cmd_dat {
			pinmux = <PINMUX_GPIO117__FUNC_CMMCLK1>;
			drive-strength = <MTK_DRIVE_6mA>;
		};
	};
	camera0_mclk_8mA: camera0_mclk_8mA@gpio117 {
		pins_cmd_dat {
			pinmux = <PINMUX_GPIO117__FUNC_CMMCLK1>;
			drive-strength = <7>;
		};
	};
	camera1_mclk_off: camera1_mclk_gpio_mode@gpio120 {
		pins_cmd_dat {
			pinmux = <PINMUX_GPIO120__FUNC_GPIO120>;
			drive-strength = <1>;
		};
	};
	camera1_mclk_2mA: camera1_mclk_2mA@gpio120 {
		pins_cmd_dat {
			pinmux = <PINMUX_GPIO120__FUNC_CMMCLK2>;
			drive-strength = <MTK_DRIVE_2mA>;
		};
	};
	camera1_mclk_4mA: camera1_mclk_4mA@gpio120 {
		pins_cmd_dat {
			pinmux = <PINMUX_GPIO120__FUNC_CMMCLK2>;
			drive-strength = <MTK_DRIVE_4mA>;
		};
	};
	camera1_mclk_6mA: camera1_mclk_6mA@gpio120 {
		pins_cmd_dat {
			pinmux = <PINMUX_GPIO120__FUNC_CMMCLK2>;
			drive-strength = <MTK_DRIVE_6mA>;
		};
	};
	camera1_mclk_8mA: camera1_mclk_8mA@gpio120 {
		pins_cmd_dat {
			pinmux = <PINMUX_GPIO120__FUNC_CMMCLK2>;
			drive-strength = <7>;
		};
	};
	camera2_mclk_off: camera2_mclk_gpio_mode@gpio116 {
		pins_cmd_dat {
			pinmux = <PINMUX_GPIO116__FUNC_GPIO116>;
			drive-strength = <1>;
		};
	};
	camera2_mclk_2mA: camera2_mclk_2mA@gpio116 {
		pins_cmd_dat {
			pinmux = <PINMUX_GPIO116__FUNC_CMMCLK0>;
			drive-strength = <MTK_DRIVE_2mA>;
		};
	};
	camera2_mclk_4mA: camera2_mclk_4mA@gpio116 {
		pins_cmd_dat {
			pinmux = <PINMUX_GPIO116__FUNC_CMMCLK0>;
			drive-strength = <MTK_DRIVE_4mA>;
		};
	};
	camera2_mclk_6mA: camera2_mclk_6mA@gpio116 {
		pins_cmd_dat {
			pinmux = <PINMUX_GPIO116__FUNC_CMMCLK0>;
			drive-strength = <MTK_DRIVE_6mA>;
		};
	};
	camera2_mclk_8mA: camera2_mclk_8mA@gpio116 {
		pins_cmd_dat {
			pinmux = <PINMUX_GPIO116__FUNC_CMMCLK0>;
			drive-strength = <7>;
		};
	};
	/* Feiping.Li@Camera.Driver, 2019/05/22, Add for 19301 rear 4 sensor */
	camera3_mclk_off: camera3_mclk_gpio_mode@gpio196 {
		pins_cmd_dat {
			pinmux = <PINMUX_GPIO196__FUNC_GPIO196>;
			drive-strength = <1>;
		};
	};
	camera3_mclk_2mA: camera3_mclk_2mA@gpio196 {
		pins_cmd_dat {
			pinmux = <PINMUX_GPIO196__FUNC_CMMCLK4>;
			drive-strength = <MTK_DRIVE_2mA>;
		};
	};
	camera3_mclk_4mA: camera3_mclk_4mA@gpio196 {
		pins_cmd_dat {
			pinmux = <PINMUX_GPIO196__FUNC_CMMCLK4>;
			drive-strength = <MTK_DRIVE_4mA>;
		};
	};
	camera3_mclk_6mA: camera3_mclk_6mA@gpio196 {
		pins_cmd_dat {
			pinmux = <PINMUX_GPIO196__FUNC_CMMCLK4>;
			drive-strength = <MTK_DRIVE_6mA>;
		};
	};
	camera3_mclk_8mA: camera3_mclk_8mA@gpio196 {
		pins_cmd_dat {
			pinmux = <PINMUX_GPIO196__FUNC_CMMCLK4>;
			drive-strength = <7>;
		};
	};
	camera4_mclk_off: camera4_mclk_gpio_mode@gpio121 {
		pins_cmd_dat {
			pinmux = <PINMUX_GPIO121__FUNC_GPIO121>;
			drive-strength = <1>;
		};
	};
	camera4_mclk_2mA: camera4_mclk_2mA@gpio121 {
		pins_cmd_dat {
			pinmux = <PINMUX_GPIO121__FUNC_CMMCLK3>;
			drive-strength = <MTK_DRIVE_2mA>;
		};
	};
	camera4_mclk_4mA: camera4_mclk_4mA@gpio121 {
		pins_cmd_dat {
			pinmux = <PINMUX_GPIO121__FUNC_CMMCLK3>;
			drive-strength = <MTK_DRIVE_4mA>;
		};
	};
	camera4_mclk_6mA: camera4_mclk_6mA@gpio121 {
		pins_cmd_dat {
			pinmux = <PINMUX_GPIO121__FUNC_CMMCLK3>;
			drive-strength = <MTK_DRIVE_6mA>;
		};
	};
	camera4_mclk_8mA: camera4_mclk_8mA@gpio121 {
		pins_cmd_dat {
			pinmux = <PINMUX_GPIO121__FUNC_CMMCLK3>;
			drive-strength = <7>;
		};
	};
	camera_mipi_switch_low: camera_mipi_switch_output_low@gpio152 {
		pins_cmd_dat {
			pinmux = <PINMUX_GPIO152__FUNC_GPIO152>;
			output-low;
		};
	};
	camera_mipi_switch_high: camera_mipi_switch_output_high@gpio152 {
		pins_cmd_dat {
			pinmux = <PINMUX_GPIO152__FUNC_GPIO152>;
			output-high;
		};
	};
	camera_pins_default: camdefault {
	};
};
&kd_camera_hw1 {
	pinctrl-names = "default",
			"cam0_rst0", "cam0_rst1",
			"cam1_rst0", "cam1_rst1",
			"cam2_rst0", "cam2_rst1",
			"cam3_rst0", "cam3_rst1",
			"cam4_rst0", "cam4_rst1",
			"cam0_ldo_vcama_0", "cam0_ldo_vcama_1",
			"cam0_ldo_vcama1_0", "cam0_ldo_vcama1_1",
			"cam0_ldo_vcamd_0", "cam0_ldo_vcamd_1",
			"cam1_ldo_vcama_0", "cam1_ldo_vcama_1",
			"cam1_ldo_vcamd_0", "cam1_ldo_vcamd_1",
			"cam2_ldo_vcama_0", "cam2_ldo_vcama_1",
			"cam2_ldo_vcamd_0", "cam2_ldo_vcamd_1",
			"cam3_ldo_vcama_0", "cam3_ldo_vcama_1",
			"cam3_ldo_vcamd_0", "cam3_ldo_vcamd_1",
			"cam4_ldo_vcama_0", "cam4_ldo_vcama_1",
			"cam4_ldo_vcamd_0", "cam4_ldo_vcamd_1",
			"cam0_mclk_off",
			"cam0_mclk_2mA", "cam0_mclk_4mA",
			"cam0_mclk_6mA", "cam0_mclk_8mA",
			"cam1_mclk_off",
			"cam1_mclk_2mA", "cam1_mclk_4mA",
			"cam1_mclk_6mA", "cam1_mclk_8mA",
			"cam2_mclk_off",
			"cam2_mclk_2mA", "cam2_mclk_4mA",
			"cam2_mclk_6mA", "cam2_mclk_8mA",
			"cam3_mclk_off",
			"cam3_mclk_2mA", "cam3_mclk_4mA",
			"cam3_mclk_6mA", "cam3_mclk_8mA",
			"cam4_mclk_off",
			"cam4_mclk_2mA", "cam4_mclk_4mA",
			"cam4_mclk_6mA", "cam4_mclk_8mA",
			"cam_mipi_switch_en_0", "cam_mipi_switch_en_1";
	pinctrl-0 = <&camera_pins_default>;
	pinctrl-1 = <&camera0_rst_low>;
	pinctrl-2 = <&camera0_rst_high>;
	pinctrl-3 = <&camera1_rst_low>;
	pinctrl-4 = <&camera1_rst_high>;
	pinctrl-5 = <&camera2_rst_low>;
	pinctrl-6 = <&camera2_rst_high>;
	pinctrl-7 = <&camera3_rst_low>;
	pinctrl-8 = <&camera3_rst_high>;
	pinctrl-9 = <&camera4_rst_low>;
	pinctrl-10 = <&camera4_rst_high>;
	pinctrl-11 = <&camera0_vcama_off>;
	pinctrl-12 = <&camera0_vcama_on>;
	pinctrl-13 = <&camera0_vcama1_off>;
	pinctrl-14 = <&camera0_vcama1_on>;
	pinctrl-15 = <&camera0_vcamd_off>;
	pinctrl-16 = <&camera0_vcamd_on>;
	pinctrl-17 = <&camera1_vcama_off>;
	pinctrl-18 = <&camera1_vcama_on>;
	pinctrl-19 = <&camera1_vcamd_off>;
	pinctrl-20 = <&camera1_vcamd_on>;
	pinctrl-21 = <&camera2_vcama_off>;
	pinctrl-22 = <&camera2_vcama_on>;
	pinctrl-23 = <&camera2_vcamd_off>;
	pinctrl-24 = <&camera2_vcamd_on>;
	pinctrl-25 = <&camera3_vcama_off>;
	pinctrl-26 = <&camera3_vcama_on>;
	pinctrl-27 = <&camera3_vcamd_off>;
	pinctrl-28 = <&camera3_vcamd_on>;
	pinctrl-29 = <&camera4_vcama_off>;
	pinctrl-30 = <&camera4_vcama_on>;
	pinctrl-31 = <&camera4_vcamd_off>;
	pinctrl-32 = <&camera4_vcamd_on>;
	pinctrl-33 = <&camera0_mclk_off>;
	pinctrl-34 = <&camera0_mclk_2mA>;
	pinctrl-35 = <&camera0_mclk_4mA>;
	pinctrl-36 = <&camera0_mclk_6mA>;
	pinctrl-37 = <&camera0_mclk_8mA>;
	pinctrl-38 = <&camera1_mclk_off>;
	pinctrl-39 = <&camera1_mclk_2mA>;
	pinctrl-40 = <&camera1_mclk_4mA>;
	pinctrl-41 = <&camera1_mclk_6mA>;
	pinctrl-42 = <&camera1_mclk_8mA>;
	pinctrl-43 = <&camera2_mclk_off>;
	pinctrl-44 = <&camera2_mclk_2mA>;
	pinctrl-45 = <&camera2_mclk_4mA>;
	pinctrl-46 = <&camera2_mclk_6mA>;
	pinctrl-47 = <&camera2_mclk_8mA>;
	pinctrl-48 = <&camera3_mclk_off>;
	pinctrl-49 = <&camera3_mclk_2mA>;
	pinctrl-50 = <&camera3_mclk_4mA>;
	pinctrl-51 = <&camera3_mclk_6mA>;
	pinctrl-52 = <&camera3_mclk_8mA>;
	pinctrl-53 = <&camera4_mclk_off>;
	pinctrl-54 = <&camera4_mclk_2mA>;
	pinctrl-55 = <&camera4_mclk_4mA>;
	pinctrl-56 = <&camera4_mclk_6mA>;
	pinctrl-57 = <&camera4_mclk_8mA>;
	pinctrl-58 = <&camera_mipi_switch_low>;
	pinctrl-59 = <&camera_mipi_switch_high>;

        cam0_vcamio-supply = <&mt_pmic_vcamio_ldo_reg>;
        cam1_vcamio-supply = <&mt_pmic_vcamio_ldo_reg>;
        cam2_vcamio-supply = <&mt_pmic_vcamio_ldo_reg>;
        cam3_vcamio-supply = <&mt_pmic_vcamio_ldo_reg>;
        cam4_vcamio-supply = <&mt_pmic_vcamio_ldo_reg>;

        cam0_enable_sensor = "imx586p2q2_mipi_raw";
        cam1_enable_sensor = "s5k3p9sp_mipi_raw";
        cam2_enable_sensor = "hi846p2q_mipi_raw";
        cam3_enable_sensor = "ov02a10p2q_mipi_mono gc02m0p2q_mipi_mono1";
        cam4_enable_sensor = "gc02m0p2q_mipi_mono ov02a10p2q_mipi_mono1";

	status = "okay";
};
/* CAMERA GPIO end */




&mt6360_pmu {
	mt6360,intr_gpio_num = <3>; /* direct defined GPIO num */
	mt6360,intr_gpio = <&pio 3 0x0>;
};

&mt6360_typec {
    /*xing.xiong@BSP.Kernel.Driver, 2018/11/06, Modify for change irq7 to irq9*/
	mt6360pd,intr_gpio_num = <9>; /* direct defined GPIO num */
	mt6360pd,intr_gpio = <&pio 9 0x0>;
};

/* USB SWITCH GPIO start */
&pio {
	usb_default: usb_default {
	};

//#ifndef VENDOR_EDIT
/* Yongzhi.Zhang@PSW.MM.AudioDriver.Machine, 2018/11/30, remove for audio I2S1 */
/*
	gpio_redriver_c1_init: c1_init {
		pins_cmd_dat {
			pinmux = <PINMUX_GPIO31__FUNC_GPIO31>;
			slew-rate = <1>;
			output-low;
		};
	};

	gpio_redriver_c1_low: c1_low {
		pins_cmd_dat {
			pinmux = <PINMUX_GPIO31__FUNC_GPIO31>;
			slew-rate = <1>;
			output-low;
		};
	};

	gpio_redriver_c1_hiz: c1_highz {
		pins_cmd_dat {
			pinmux = <PINMUX_GPIO31__FUNC_GPIO31>;
			slew-rate= <0>;
			bias-disable;
		};
	};

	gpio_redriver_c1_high: c1_high {
		pins_cmd_dat {
			pinmux = <PINMUX_GPIO31__FUNC_GPIO31>;
			slew-rate = <1>;
			output-high;
		};
	};

	gpio_redriver_c2_init: c2_init {
		pins_cmd_dat {
			pinmux = <PINMUX_GPIO30__FUNC_GPIO30>;
			slew-rate = <1>;
			output-low;
		};
	};

	gpio_redriver_c2_low: c2_low {
		pins_cmd_dat {
			pinmux = <PINMUX_GPIO30__FUNC_GPIO30>;
			slew-rate = <1>;
			output-low;
		};
	};

	gpio_redriver_c2_hiz: c2_highz {
		pins_cmd_dat {
			pinmux = <PINMUX_GPIO30__FUNC_GPIO30>;
			slew-rate= <0>;
			bias-disable;
		};
	};

	gpio_redriver_c2_high: c2_high {
		pins_cmd_dat {
			pinmux = <PINMUX_GPIO30__FUNC_GPIO30>;
			slew-rate = <1>;
			output-high;
		};
	};

	gpio_u3_switch_sel1: u3_sw_sel1 {
		pins_cmd_dat {
			pinmux = <PINMUX_GPIO32__FUNC_GPIO32>;
			slew-rate = <1>;
			output-low;
		};
	};

	gpio_u3_switch_sel2: u3_sw_sel2 {
		pins_cmd_dat {
			pinmux = <PINMUX_GPIO32__FUNC_GPIO32>;
			slew-rate = <1>;
			output-high;
		};
	};
*/
//#else /* VENDOR_EDIT */
	gpio_redriver_c1_init: c1_init {
	};

	gpio_redriver_c1_low: c1_low {
	};

	gpio_redriver_c1_hiz: c1_highz {
	};

	gpio_redriver_c1_high: c1_high {
	};

	gpio_redriver_c2_init: c2_init {
	};

	gpio_redriver_c2_low: c2_low {
	};

	gpio_redriver_c2_hiz: c2_highz {
	};

	gpio_redriver_c2_high: c2_high {
	};

	gpio_u3_switch_sel1: u3_sw_sel1 {
	};

	gpio_u3_switch_sel2: u3_sw_sel2 {
	};
//#endif /* VENDOR_EDIT */

	gpio_u3_switch_enable: u3_sw_en {
	};

	gpio_u3_switch_disable: u3_sw_dis {
	};
};

&usb_c_pinctrl {
	pinctrl-names = "usb_default",
		"redrv_c1_init",
		"redrv_c1_low",
		"redrv_c1_hiz",
		"redrv_c1_high",
		"redrv_c2_init",
		"redrv_c2_low",
		"redrv_c2_hiz",
		"redrv_c2_high",
		"switch_sel1",
		"switch_sel2",
		"switch_enable",
		"switch_disable";

	pinctrl-0 = <&usb_default>;
	pinctrl-1 = <&gpio_redriver_c1_init>;
	pinctrl-2 = <&gpio_redriver_c1_low>;
	pinctrl-3 = <&gpio_redriver_c1_hiz>;
	pinctrl-4 = <&gpio_redriver_c1_high>;
	pinctrl-5 = <&gpio_redriver_c2_init>;
	pinctrl-6 = <&gpio_redriver_c2_low>;
	pinctrl-7 = <&gpio_redriver_c2_hiz>;
	pinctrl-8 = <&gpio_redriver_c2_high>;
	pinctrl-9 = <&gpio_u3_switch_sel1>;
	pinctrl-10 = <&gpio_u3_switch_sel2>;
	pinctrl-11 = <&gpio_u3_switch_enable>;
	pinctrl-12 = <&gpio_u3_switch_disable>;
	status = "okay";

	usb_switch-data {
		en_pin_num = <0>;
		en_pin_val = <0>;
		sel_pin_num = <32>;
		sel_pin_val = <1>;
		c1_pin_num = <31>;
		c1_pin_val = <2>;
		c2_pin_num = <30>;
		c2_pin_val = <1>;
	};
};
/* USB SWITCH GPIO end */

/* CONSYS GPIO standardization */
&pio {
	consys_pins_default: consys_default {
	};
	gpslna_pins_init: gpslna@0 {
		pins_cmd_dat {
			pinmux = <PINMUX_GPIO147__FUNC_GPIO147>;
			//#ifndef VENDOR_EDIT
			//Wenjie.Liu@PSW.CN.GPS.Hardware.Power.1202743, 2017/12/29,
			//modify for: [GPS_LNA gpio's output direction is out]
			/*
			slew-rate = <0>;
			*/
			//#else /* VENDOR_EDIT */
			slew-rate = <1>;
			//#endif /* VENDOR_EDIT */
			bias-disable;
			output-low;
		};
	};
	gpslna_pins_oh: gpslna@1 {
		pins_cmd_dat {
			pinmux = <PINMUX_GPIO147__FUNC_GPIO147>;
			slew-rate = <1>;
			output-high;
		};
	};
	gpslna_pins_ol: gpslna@2 {
		pins_cmd_dat {
			pinmux = <PINMUX_GPIO147__FUNC_GPIO147>;
			slew-rate = <1>;
			output-low;
		};
	};
};
&consys {
	pinctrl-names = "default", "gps_lna_state_init",
		"gps_lna_state_oh", "gps_lna_state_ol";
	pinctrl-0 = <&consys_pins_default>;
	pinctrl-1 = <&gpslna_pins_init>;
	pinctrl-2 = <&gpslna_pins_oh>;
	pinctrl-3 = <&gpslna_pins_ol>;
	status = "okay";
};
/* CONSYS end */

//#ifdef VENDOR_EDIT /* Jianchao.Shi@BSP.CHG.Basic, 2018/11/09, sjc Add for charging */
&odm {
	vooc_ap_data:vooc_ap_data {
		compatible = "mediatek, VOOC_AP_DATA-eint";
		interrupts = <14 IRQ_TYPE_EDGE_FALLING 14 0>;
	};
	vooc_ap_data_new_function:vooc_ap_data_new_function {
		compatible = "mediatek, VOOC_EINT_NEW_FUNCTION";
	};
};

&charger {
	pinctrl-names = "default", "charger_gpio_as_output_low", "charger_gpio_as_output_high",
					"ship_sleep", "ship_active", "dischg_enable", "dischg_disable";
	pinctrl-0 = <&charger_pins_default>;
	pinctrl-1 = <&charger_pins_eint_output0>;
	pinctrl-2 = <&charger_pins_eint_output1>;
	pinctrl-3 = <&ship_sleep_gpio>;
	pinctrl-4 = <&ship_active_gpio>;
	pinctrl-5 = <&dischg_enable>;
	pinctrl-6 = <&dischg_disable>;
	//pinctrl-5 = <&shortc_active_gpio>;

	//for oppo chg framework:
	qcom,input_current_charger_ma = <2000>;
	qcom,input_current_usb_ma = <500>;
	qcom,input_current_cdp_ma = <1500>;
	qcom,input_current_led_ma = <1200>;
	qcom,input_current_led_ma_forcmcc = <500>;
	qcom,input_current_camera_ma = <1200>;
	qcom,input_current_calling_ma = <1500>;

	qcom,iterm_disabled = <0>;
	qcom,iterm_ma = <205>;
	qcom,recharge-mv = <115>;

	qcom,batt_capacity_mah = <4000>; /*typical capacity*/
	//qcom,batt_capacity_mah = <3900>; /*rated capacity*/

	qcom,removed_bat_decidegc = <190>;  /* < -19C */

	qcom,cold_bat_decidegc = <20>;  /* -3C ~ 0C */
	qcom,temp_cold_vfloat_mv = <3980>;
	qcom,temp_cold_fastchg_current_ma = <360>;

	qcom,little_cold_bat_decidegc = <0>;	/* 0C ~ 5C */
	qcom,temp_little_cold_vfloat_mv = <4385>;
	qcom,temp_little_cold_fastchg_current_ma_high = <1850>;
	qcom,temp_little_cold_fastchg_current_ma_low = <1100>;
	qcom,temp_little_cold_fastchg_current_ma = <1100>;

	qcom,cool_bat_decidegc = <50>;	/* 5C ~ 12C */
	qcom,temp_cool_vfloat_mv = <4385>;
	qcom,temp_cool_fastchg_current_ma_high = <2100>;
	qcom,temp_cool_fastchg_current_ma_low = <1850>;

	qcom,little_cool_bat_decidegc = <120>;	/* 12C ~ 16C */
	qcom,temp_little_cool_vfloat_mv = <4385>;
	qcom,temp_little_cool_fastchg_current_ma = <2100>;

	qcom,normal_bat_decidegc = <160>;	/* 16C ~ 45C */
	qcom,temp_normal_fastchg_current_ma = <2100>;
	qcom,temp_normal_vfloat_mv = <4385>;

	qcom,warm_bat_decidegc = <450>;		/* 45C ~ 53C */ /*8pin Bat Vooc project need add 3 degree C*/
	qcom,temp_warm_vfloat_mv = <4130>;
	qcom,temp_warm_fastchg_current_ma = <1100>;

	qcom,hot_bat_decidegc = <530>;  /* > 53C */

	qcom,non_standard_vfloat_mv = <3980>;
	qcom,non_standard_fastchg_current_ma = <512>;

	qcom,short_c_bat_cv_mv = <4330>;
	qcom,short_c_bat_vfloat_mv = <3800>;
	qcom,short_c_bat_fastchg_current_ma = <512>;
	qcom,short_c_bat_vfloat_sw_limit = <3750>;

	qcom,cold_vfloat_sw_limit = <3930>;
	qcom,little_cold_vfloat_sw_limit = <4335>;
	qcom,cool_vfloat_sw_limit = <4335>;
	qcom,little_cool_vfloat_sw_limit = <4335>;
	qcom,normal_vfloat_sw_limit = <4335>;
	qcom,warm_vfloat_sw_limit = <4080>;
	qcom,non_standard_vfloat_sw_limit = <3930>;

	qcom,max_chg_time_sec = <36000>;
	qcom,charger_hv_thr = <5800>;
	qcom,charger_lv_thr = <3400>;
	qcom,vbatt_full_thr = <4400>;
	qcom,vbatt_hv_thr = <4500>;

	qcom,vfloat_step_mv = <10>;
	qcom,non_standard_vfloat_over_sw_limit = <3980>;
	qcom,cold_vfloat_over_sw_limit = <3980>;
	qcom,little_cold_vfloat_over_sw_limit = <4390>;
	qcom,cool_vfloat_over_sw_limit = <4390>;
	qcom,little_cool_vfloat_over_sw_limit = <4390>;
	qcom,normal_vfloat_over_sw_limit = <4390>;
	qcom,warm_vfloat_over_sw_limit = <4130>;

	qcom,vbatt_power_off = <3300>;
	qcom,vbatt_soc_1 = <3410>;
	qcom,vooc_project = <1>;
	qcom,vbatt_num = <1>;

	qcom,normal_vterm_hw_inc = <150>;
	qcom,non_normal_vterm_hw_inc = <10>;

	qcom,ff1_normal_fastchg_ma = <1200>;
	qcom,ff1_warm_fastchg_ma = <1200>;
	qcom,ffc2_normal_fastchg_ma = <700>;/*12C~35c*/
	qcom,ffc2_warm_fastchg_ma = <800>;/*35C~40c*/
	qcom,ffc2_temp_high_decidegc = <400>;
	qcom,ffc2_temp_warm_decidegc = <350>;
	qcom,ffc2_temp_low_decidegc = <120>;
	qcom,ff1_exit_step_ma = <680>;
	qcom,ff1_warm_exit_step_ma = <630>;
	qcom,ffc2_exit_step_ma = <180>;
	qcom,ffc2_warm_exit_step_ma = <230>;

	qcom,ffc_normal_vfloat_sw_limit = <4430>;
	qcom,ffc2_normal_vfloat_sw_limit = <4430>;
	qcom,ffc_temp_normal_vfloat_mv = <4500>;
	qcom,ffc_normal_vfloat_over_sw_limit = <4500>;

	qcom,default_iterm_ma = <205>;
	qcom,default_temp_normal_fastchg_current_ma = <2100>;
	qcom,default_normal_vfloat_sw_limit = <4335>;
	qcom,default_temp_normal_vfloat_mv = <4385>;
	qcom,default_normal_vfloat_over_sw_limit = <4390>;

	//for control:
	//qcom,suspend_after_full;
	qcom,check_batt_full_by_sw;
	qcom,external_gauge;
	qcom,chg_ctrl_by_calling;
	qcom,chg_ctrl_by_lcd;
	qcom,chg_ctrl_by_camera;
	qcom,sw_vfloat_over_protect_enable;
	qcom,ffc_support;

	//GPIO config:
	qcom,chargerid_switch-gpio = <&pio 195 0x00>;
	qcom,ship-gpio = <&pio 69 0x00>;
	qcom,dischg-gpio = <&pio 35 0x00>;
	//qcom,shortc-gpio = <&pio 121 0x00>;
};

&i2c7 {
	bq27541-battery@55 {
		status = "okay";
		compatible = "oppo,bq27541-battery";
		reg = <0x55 0>;
		qcom,modify-soc-smooth;
	};
/*
	n76e_fastcg@52{
		status = "okay";
		compatible = "oppo,n76e-fastcg";
		reg = <0x52 0>;
		qcom,vooc-low-temp = <120>;
		qcom,oppo_batt_4400mv;
		qcom,vooc_fw_update_newmethod;
		qcom,vooc-fw-type = <2>;

		pinctrl-names = "switch1_act_switch2_act", "switch1_sleep_switch2_sleep",
						"switch1_act_switch3_act", "switch1_sleep_switch3_sleep",
						"switch1_act_switch2_sleep", "switch1_sleep_switch2_act",
						"clock_active","clock_sleep",
						"data_active","data_sleep",
						"reset_active","reset_sleep",
						"vooc_mcu_id_default";
		pinctrl-0 = <&charging_switch1_active>;
		pinctrl-1 = <&charging_switch1_sleep>;
		pinctrl-2 = <&charging_switch1_active>;
		pinctrl-3 = <&charging_switch1_sleep>;
		pinctrl-4 = <&charging_switch1_active>;
		pinctrl-5 = <&charging_switch1_sleep>;
		pinctrl-6 = <&charging_clock_active>;
		pinctrl-7 = <&charging_clock_sleep>;
		pinctrl-8 = <&charging_data_active>;
		pinctrl-9 = <&charging_data_sleep>;
		pinctrl-10 = <&charging_reset_active>;
		pinctrl-11 = <&charging_reset_sleep>;
		pinctrl-12 = <&vooc_mcu_id_default>;

		qcom,charging_switch1-gpio 		= <&pio 74 0x00>;
		//qcom,charging_switch2-gpio 		= <&tlmm 113 0x00>;
		//qcom,charging_switch3-gpio 		= <&tlmm 38 0x00>;

		qcom,charging_reset-gpio 			= <&pio 21 0x00>;
		qcom,charging_clock-gpio 			= <&pio 15 0x00>;
		qcom,charging_data-gpio 			= <&pio 14 0x00>;
		qcom,vooc_mcu_id-gpio				= <&pio 38 0x00>;
	};
*/
	stm8s_fastcg@26{
		status = "okay";
		compatible = "oppo,stm8s-fastcg";
		reg = <0x26 0>;
		qcom,vooc-low-temp = <120>;
		qcom,oppo_batt_4400mv;
		qcom,vooc_fw_update_newmethod;
		qcom,vooc-fw-type = <8>;

		pinctrl-names = "switch1_act_switch2_act", "switch1_sleep_switch2_sleep",
						"switch1_act_switch3_act", "switch1_sleep_switch3_sleep",
						"switch1_act_switch2_sleep", "switch1_sleep_switch2_act",
						"clock_active","clock_sleep",
						"data_active","data_sleep",
						"reset_active","reset_sleep",
						"vooc_mcu_id_default";
		pinctrl-0 = <&charging_switch1_active>;
		pinctrl-1 = <&charging_switch1_sleep>;
		pinctrl-2 = <&charging_switch1_active>;
		pinctrl-3 = <&charging_switch1_sleep>;
		pinctrl-4 = <&charging_switch1_active>;
		pinctrl-5 = <&charging_switch1_sleep>;
		pinctrl-6 = <&charging_clock_active>;
		pinctrl-7 = <&charging_clock_sleep>;
		pinctrl-8 = <&charging_data_active>;
		pinctrl-9 = <&charging_data_sleep>;
		pinctrl-10 = <&charging_reset_active>;
		pinctrl-11 = <&charging_reset_sleep>;
		pinctrl-12 = <&vooc_mcu_id_default>;

		qcom,charging_switch1-gpio 		= <&pio 74 0x00>;
		//qcom,charging_switch2-gpio 		= <&tlmm 113 0x00>;
		//qcom,charging_switch3-gpio 		= <&tlmm 38 0x00>;

		qcom,charging_reset-gpio 			= <&pio 21 0x00>;
		qcom,charging_clock-gpio 			= <&pio 15 0x00>;
		qcom,charging_data-gpio 			= <&pio 14 0x00>;
		qcom,vooc_mcu_id-gpio				= <&pio 38 0x00>;
	};
};

&pio {
	charger_pins_default: eint0default {
	};
	charger_pins_eint_output0: charger_gpio_as_output_low {
		pins_cmd_dat {
			pinmux = <PINMUX_GPIO195__FUNC_GPIO195>;
			slew-rate = <1>;
			output-low;
		};
	};
	charger_pins_eint_output1: charger_gpio_as_output_high {
		pins_cmd_dat {
			pinmux = <PINMUX_GPIO195__FUNC_GPIO195>;
			slew-rate = <1>;
			output-high;
		};
	};

	ship_sleep_gpio: ship_sleep {
		pins_cmd_dat {
			pinmux = <PINMUX_GPIO69__FUNC_GPIO69>;
			slew-rate = <1>;
			output-low;
		};
	};
	ship_active_gpio: ship_active {
		pins_cmd_dat {
			pinmux = <PINMUX_GPIO69__FUNC_GPIO69>;
			slew-rate = <1>;
			output-high;
		};
	};

	dischg_enable: dischg_enable {
		pins_cmd_dat {
			pinmux = <PINMUX_GPIO35__FUNC_GPIO35>;
			slew-rate = <1>;//0:input direction 1:output direction
			bias-pull-up = <00>;
			output-high;
		};
	};

	dischg_disable: dischg_disable {
		pins_cmd_dat {
			pinmux = <PINMUX_GPIO35__FUNC_GPIO35>;
			slew-rate = <1>;
			bias-pull-down = <00>;
			output-low;
		};
	};
/*
	shortc_active_gpio: shortc_active {
		pins_cmd_dat {
			pinmux = <PINMUX_GPIO121__FUNC_GPIO121>;
			input-enable;
			slew-rate = <0>;
			bias-pull-up;
		};
	};
*/
};

&pio {
	charging_switch1_active: charging_switch1_active {
		pins_cmd_dat {
			pinmux = <PINMUX_GPIO74__FUNC_GPIO74>;
			slew-rate = <1>;
			output-high;
		};
	};
	charging_switch1_sleep: charging_switch1_sleep {
		pins_cmd_dat {
			pinmux = <PINMUX_GPIO74__FUNC_GPIO74>;
			slew-rate = <1>;
			output-low;
		};
	};
	charging_clock_active: charging_clock_active {
		pins_cmd_dat {
			pinmux = <PINMUX_GPIO15__FUNC_GPIO15>;
			slew-rate = <0>;
			bias-pull-up = <00>;
		};
	};
	charging_clock_sleep: charging_clock_sleep {
		pins_cmd_dat {
			pinmux = <PINMUX_GPIO15__FUNC_GPIO15>;
			slew-rate = <0>;
			bias-pull-down = <00>;
		};
	};
	charging_data_active: charging_data_active {
		pins_cmd_dat {
			pinmux = <PINMUX_GPIO14__FUNC_GPIO14>;
			slew-rate = <0>;
			bias-pull-up = <00>;
		};
	};
	charging_data_sleep: charging_data_sleep {
		pins_cmd_dat {
			pinmux = <PINMUX_GPIO14__FUNC_GPIO14>;
			slew-rate = <0>;
			bias-pull-down = <00>;
		};
	};
	charging_reset_active: charging_reset_active {
		pins_cmd_dat {
			pinmux = <PINMUX_GPIO21__FUNC_GPIO21>;
			slew-rate = <1>;
			output-high;
		};
	};
	charging_reset_sleep: charging_reset_sleep {
		pins_cmd_dat {
			pinmux = <PINMUX_GPIO21__FUNC_GPIO21>;
			slew-rate = <1>;
			output-low;
		};
	};
	vooc_mcu_id_default: vooc_mcu_id_default {
		pins_cmd_dat {
			pinmux = <PINMUX_GPIO38__FUNC_GPIO38>;
			input-enable;
			slew-rate = <0>;
			bias-pull-up;
		};
	};
};

//#ifdef VENDOR_EDIT
//Jianchao.Shi@PSW.BSP.CHG.Basic, 2018/10/11, sjc Add for chargerid
&apuart0 {
	pinctrl-names = "uart0_rx_gpio",
			"uart0_tx_gpio";
	pinctrl-0 = <&uart0_rx_gpio_input>;
	pinctrl-1 = <&uart0_tx_gpio_input>;
	status = "okay";
};

&pio {
	uart0_rx_gpio_input:uart0_rx_gpio@gpio53 {
		pins_cmd_dat {
			pinmux = <PINMUX_GPIO53__FUNC_GPIO53>;
			input-enable;
			slew-rate = <0>;
			bias-disable;
		};
	};
	uart0_tx_gpio_input:uart0_tx_gpio@gpio54 {
		pins_cmd_dat {
			pinmux = <PINMUX_GPIO54__FUNC_GPIO54>;
			input-enable;
			slew-rate = <0>;
			bias-disable;
		};
	};
};
//#endif

//#ifdef VENDOR_EDIT
//Jianchao.Shi@PSW.BSP.CHG.Basic, 2019/07/01, sjc Add for zhongying fg ZY0602
&i2c7 {
	pinctrl-names = "i2c-state", "output-low-state";
	pinctrl-0 = <&fg_i2c_state>;
	pinctrl-1 = <&fg_i2c_output_low_state>;
};

&pio {
	fg_i2c_state: fg_i2c_sda_state {
		pins_cmd_dat {
			pinmux = <PINMUX_GPIO199__FUNC_SDA7>;
			slew-rate = <0>;
			bias-disable;
		};
	};
	fg_i2c_output_low_state: fg_i2c_sda_output_low_state {
		pins_cmd_dat {
			pinmux = <PINMUX_GPIO199__FUNC_GPIO199>;
			slew-rate = <1>;
			output-low;
		};
	};
};
//#endif
//#endif /* VENDOR_EDIT */

//ifdef VENDOR_EDIT
/* Long.Liu@PSW.BSP.Fingerprint.Basic, 2018/11/19, Add for FPC driver baseon trustonic tee */
&pio {
	/* SPI0: cs set, cs clear, clk set, clk clear
			miso set, miso clear, mosi set, mosi clear*/
		spi0_gpio_def_cfg:spi0_gpio_default{

	};
	spi0_cs_set_cfg:spi0_cs_set{
		pins_cmd_dat {
			pinmux = <PINMUX_GPIO19__FUNC_SPI0_A_CSB>;
			input-enable;
		};
	};
	spi0_cs_clr_cfg:spi0_cs_clear{
		pins_cmd_dat {
			pinsmux = <PINMUX_GPIO19__FUNC_GPIO19>;
			slew-rate = <0>;
			input-disable;
			bias-disable;
			input-schmitt-enable;
		};
	};
	spi0_clk_set_cfg:spi0_clk_set{
		pins_cmd_dat {
			pinmux = <PINMUX_GPIO20__FUNC_SPI0_A_CLK>;
			input-enable;
		};
	};
	spi0_clk_clr_cfg:spi0_clk_clear{
		pins_cmd_dat {
			pinmux = <PINMUX_GPIO20__FUNC_GPIO20>;
			slew-rate = <0>;
			input-disable;
			bias-disable;
			input-schmitt-enable;
		};
	};
	spi0_miso_set_cfg:spi0_miso_set{
		pins_cmd_dat {
			pinmux = <PINMUX_GPIO17__FUNC_SPI0_A_MI>;
			input-enable;
		};
	};
	spi0_miso_clr_cfg:spi0_miso_clear{
		pins_cmd_dat {
			pinmux = <PINMUX_GPIO17__FUNC_GPIO17>;
			slew-rate = <0>;
			input-disable;
			bias-disable;
			input-schmitt-enable;
		};
	};
	spi0_mosi_set_cfg:spi0_mosi_set{
		pins_cmd_dat {
			pinmux = <PINMUX_GPIO18__FUNC_SPI0_A_MO>;
			input-enable;
		};
	};
	spi0_mosi_clr_cfg:spi0_mosi_clear{
		pins_cmd_dat {
			pinmux = <PINMUX_GPIO18__FUNC_GPIO18>;
			slew-rate = <0>;
			input-disable;
			bias-disable;
			input-schmitt-enable;
		};
	};
};
/* SPI GPIO Settings - End */
//#endif/*VENDOR_EDIT*/

//ifdef VENDOR_EDIT
/* Long.Liu@PSW.BSP.Fingerprint.Basic, 2018/11/19, Add for FPC driver baseon trustonic tee */
/* fpc spi */
/*Because it is not compatible with 18151-fpc and 18073-silead now.So temporarily block*/
//&fpc_spi{
//	pinctrl-names = "default";
//	pinctrl-0 = <&spi0_cs_set_cfg>,<&spi0_clk_set_cfg>,<&spi0_miso_set_cfg>,<&spi0_mosi_set_cfg>;
//	status = "okay";
//};
/* fpc GPIO standardization */

&pio {
	fpc_reset_default: fpc_reset_default {
		pins_cmd_dat {
			pinmux = <PINMUX_GPIO107__FUNC_GPIO107>;
			slew-rate = <1>;
			output-low;
		};
	};
	fpc_irq_default: fpc_irq_default {
		pins_cmd_dat {
			pinmux = <PINMUX_GPIO39__FUNC_GPIO39>;
			slew-rate = <0>;
			bias-pull-up = <00>;
		};
	};
};

/*Because it is not compatible with 18151-fpc and 18073-silead now.So temporarily block*/
//&fpc_interrupt {
//	pinctrl-names = "default";
//	fpc,irq-gpio    = <&pio 39 0x00>;
//	fpc,reset-gpio  = <&pio 107 0x00>;
//	vdd_io-supply = <&mt_pmic_vfp_ldo_reg>;
//	pinctrl-0 = <&fpc_reset_default>,<&fpc_irq_default>;
//	status = "okay";
//};
/*the id config to project dts.*/
&pio{
	gpio_id0_default: gpio_id0_default {
		pins_cmd_dat {
			pinmux = <PINMUX_GPIO201__FUNC_GPIO201>;
			slew-rate = <0>;
			bias-pull-up = <00>;
			input-enable;
		};
	};
};

&mt6360_ldo {
	ldo1_ctrls = [00 80 01 2d 44];
	ldo1 {
		regulator-min-microvolt = <1800000>;
		regulator-max-microvolt = <1800000>;
		regulator-boot-on;
		regulator-always-on;
	};
};
&oppo_fp_common {
	oppo,fp_gpio = <503>;
	pinctrl-names = "default";
	pinctrl-0 = <&gpio_id0_default>;
	goodix_id {
		oppo,fp-id = <1>; /* fp id mapping table */
		vendor-chip = <11>; /* please refer to the struct fp_vendor_t in oppo_fp_commmon.n */
		eng-menu = "-1,-1"; /* represents SNR, inclination test item in engineer menu, and 0/1 means off/on */
		chip-name = "G_OPTICAL_G3";  /* /proc/fp_id, will be displayed in engineer menu  */
	};
	silead_id {
		oppo,fp-id = <0>; /* fp id mapping table */
		vendor-chip = <13>; /* please refer to the struct fp_vendor_t in oppo_fp_commmon.n */
		eng-menu = "-1,-1"; /* represents SNR, inclination test item in engineer menu, and 0/1 means off/on */
		chip-name = "S_OPTICAL_70";  /* /proc/fp_id, will be displayed in engineer menu  */
	};
};

/* Bangxiong.Wu@PSW.BSP.Fingerprint.Basic, 2019/01/24, Add for silead driver baseon trustonic tee */
/* silead fp start */
&pio {
	silfp_default: silfp_default {
	};

	silfp_rst_high: silfp_rst_high {
		pins_cmd_dat {
			pinmux = <PINMUX_GPIO107__FUNC_GPIO107>;
			slew-rate = <1>;
			output-high;
		};
	};

	silfp_rst_low: silfp_rst_low {
		pins_cmd_dat {
			pinmux = <PINMUX_GPIO107__FUNC_GPIO107>;
			slew-rate = <1>;
			output-low;
		};
	};

	silfp_irq: silfp_irq {
		pins_cmd_dat {
			pinmux = <PINMUX_GPIO39__FUNC_GPIO39>;
			slew-rate = <0>;
			bias-disable;
		};
	};
	fingerprint_pins_default: fingerprint_pins_default {
		pins_cmd_dat {
			pinmux = <PINMUX_GPIO19__FUNC_SPI0_A_CSB>;
			slew-rate = <1>;
			bias-pull-up;
                        drive-strength = <3>; /* 8mA */
		};

		pins_cmd2_dat {
			pinmux = <PINMUX_GPIO20__FUNC_SPI0_A_CLK>;
			slew-rate = <1>;
			bias-pull-down;
                        drive-strength = <3>; /* 8mA */
		};

		pins_cmd3_dat {
			pinmux = <PINMUX_GPIO17__FUNC_SPI0_A_MI>;
			slew-rate = <0>;
			bias-pull-down;
                        drive-strength = <3>; /* 8mA */
		};

		pins_cmd4_dat {
			pinmux = <PINMUX_GPIO18__FUNC_SPI0_A_MO>;
			slew-rate = <1>;
			bias-pull-down;
                        drive-strength = <3>; /* 8mA */
		};
	};
};
&silead_fp {
	pinctrl-names = "default", "rst-low", "rst-high" ,
	                "irq-init", "spi-default";
	pinctrl-0 = <&silfp_default>;
	pinctrl-1 = <&silfp_rst_low>;
	pinctrl-2 = <&silfp_rst_high>;
	pinctrl-3 = <&silfp_irq>;
	pinctrl-4 = <&fingerprint_pins_default>;
	status = "okay";
};
/* silead fp end */
//#endif /* VENDOR_EDIT */

//#ifdef VENDOR_EDIT
/*Dongnan.Wu@BSP.Fingerprint.Basic, 2019/02/23, add goodix dts support & compatible goodix & silead spi device */
&pio{
    gpio_goodix_reset_default: gpio_goodix_reset_default {
        pins_cmd_dat {
            pinmux = <PINMUX_GPIO107__FUNC_GPIO107>;
            slew-rate = <1>;
            output-low;
        };
    };
    gpio_goodix_irq_default: gpio_goodix_irq_default {
        pins_cmd_dat {
            pinmux = <PINMUX_GPIO39__FUNC_GPIO39>;
            slew-rate = <0>;
            bias-pull-down;
        };
    };
    //#ifdef VENDOR_EDIT
    /*Dongnan.Wu@BSP.Fingerprint.Basic, 2019/03/18, modify for goodix spi drive strength*/
    gpio_goodix_clk_6mA: gpio_goodix_clk_6mA {
        pins_cmd_dat {
            pinmux = <PINMUX_GPIO20__FUNC_SPI0_A_CLK>;
            drive-strength = <2>;
        };
    };
    gpio_goodix_mosi_6mA: gpio_goodix_mosi_6mA {
        pins_cmd_dat {
            pinmux = <PINMUX_GPIO18__FUNC_SPI0_A_MO>;
            drive-strength = <2>;
        };
    };
    gpio_goodix_miso_6mA: gpio_goodix_miso_6mA {
        pins_cmd_dat {
            pinmux = <PINMUX_GPIO17__FUNC_SPI0_A_MI>;
            drive-strength = <3>;
        };
    };
    gpio_goodix_cs_6mA: gpio_goodix_cs_6mA {
        pins_cmd_dat {
            pinmux = <PINMUX_GPIO19__FUNC_SPI0_A_CSB>;
            drive-strength = <2>;
        };
    };
    /*Bangxiong.Wu@BSP.Fingerprint.Basic,2019/04/05,add for revert CS to FUNC*/
    gpio_goodix_cs_func: gpio_goodix_cs_func {
        pins_cmd_dat {
            pinmux = <PINMUX_GPIO19__FUNC_SPI0_A_CSB>;
            drive-strength = <2>;
        };
    };
    //#endif /*VENDOR_EDIT*/
};

&spi0 {
    #address-cells = <1>;
    #size-cells = <0>;
    status = "okay";
    oppo_fp: fingerprint@0 {
        compatible = "oppo,oppo_fp";
        reg = <0>;
        spi-max-frequency = <8000000>;
        spi-id = <0>;
        spi-irq = <39>;
        spi-reg = <11010000>;
        avdd-supply = <&mt_pmic_vfp_ldo_reg>;
        status = "okay";
        avdd-config = <3300000 3300000 150000>;
        dvdd-config = <1800000 1800000 150000>;
        power_source_1 {
            power-mode = <1>;
            power-name = "avdd";
            power-config = "avdd-config";
            delay-time = <0>;
        };
        power_source_2 {
            power-mode = <1>;
            power-name = "dvdd";
            power-config = "dvdd-config";
            delay-time = <0>;
        };
    };
};

&goodix_fp {
    goodix,gpio_irq = <&pio 39 0x00>;
    goodix,gpio_reset = <&pio 107 0x00>;
    //#ifdef VENDOR_EDIT
    //Dongnan.Wu@BSP.Fingerprint.Basic, 2019/05/24, add power enable gpio for goodix G3
    goodix,pw_en = <&pio 200 0x00>;
    //#endif /* VENDOR_EDIT */
    goodix,gpio_cs = <&pio 19 0x00>;
    pinctrl-names = "default", "gf_spi_drive_6mA", "gf_cs_func";
    pinctrl-0 = <&gpio_goodix_irq_default>, <&gpio_goodix_reset_default>;
    pinctrl-1 = <&gpio_goodix_clk_6mA>, <&gpio_goodix_mosi_6mA>, <&gpio_goodix_miso_6mA>, <&gpio_goodix_cs_6mA>;
    pinctrl-2 = <&gpio_goodix_cs_func>;
    status = "okay";
};
//#endif /* VENDOR_EDIT */

//#ifdef VENDOR_EDIT
//runyu.ouyang@PSW.BSP.STORAGE, 2019/05/23, Add for SD-card
&msdc1 {
    cd-gpios = <&pio 202 0>;
    status = "okay";
    vmmc-supply = <&mt_pmic_vmch_ldo_reg>;
};
/* yu.hu@PSW.BSP.Kernel.Driver, 2019/12/17, Modify for T_card eint, low active change to high active */
&mt6360_ldo {
	ldo5_ctrls = [00 80 01 2d a4];
};
//#endif  /*VENDOR_EDIT*/
#include <oppo6779_19301/cust.dtsi>
/*End of this file, DO NOT ADD ANYTHING HERE*/
