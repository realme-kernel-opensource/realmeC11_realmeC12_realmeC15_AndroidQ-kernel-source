## drivers/misc/mediatek/leds/Kconfig
```kconfig
config MTK_LEDS
	tristate "MediaTek LED Support"
	depends on LEDS_CLASS
	---help---
	  This selects the MediaTek(R) LEDs connected to MediaTek chips.
	  If you want to use MediaTek(R) LEDs support, say Y or M here.
	  If unsure, say N.
	  Mediatek LED module includes backlight, indicate LED, keypad LED, button LED etc.

config LIGHTNESS_MAPPING_VALUE
	int "Backlight brightness mapping value"
	default 255
	---help---
	  Backlight brightness mapping value, from 0 to 255.

config BACKLIGHT_SUPPORT_LP8557
	bool "Support backlight lp8557 board"
	default n
	---help---
	  LED driver for LP8557 support.
	  Set y to support.
	  Set n to disable.
	  For pwm external backlight.

config BACKLIGHT_SUPPORT_LM3697
	bool "LM3697(DW8832) Support"
	default n
	---help---
	  LED driver for lm3697(dw8832) support.
	  Set y to support.
	  Set n to disable.
	  Charge pump driver for external backlight.
#ifdef VENDOR_EDIT
#Bin.Li@BSP.Fingerprint.Secure 2019/04/12, Add for led ic ktd2026
source "drivers/misc/mediatek/leds/mt6779/oppo_ktd2026/Kconfig"
source "drivers/misc/mediatek/leds/mt6779/oppo_ktd2026b/Kconfig"
#Bin.Li@BSP.Fingerprint.Secure 2019/04/12, Add for led ic aw2026
source "drivers/misc/mediatek/leds/mt6779/oppo_aw2026/Kconfig"
#endif
```

## drivers/misc/mediatek/leds/mt6779/oppo_aw2026/Kconfig
```kconfig
config AW2026_SLED
	bool "AW2026 for MediaTek package"
	default n
	help
	  It support AW2026.
          If this option is set,
	  it will support
          AW2026.
```

## drivers/misc/mediatek/leds/mt6779/oppo_ktd2026/Kconfig
```kconfig
config OPPO_BACKLIGHT_KTD2026
	bool "KTD2026 for MediaTek package"
	default n
	help
	  It support KTD2026.
          If this option is set,
	  it will support
          KTD2026.
```

## drivers/misc/mediatek/sensors-1.0/situation/sar_modem/Kconfig
```kconfig
config MTK_SAR_MODEM_HUB
	bool "sar_modem_hub for MediaTek package"
	default n
	help
	SAR sensor is a physical device,
	that detect distance between the body and device.
	This sensor type is design for modem through scp,
	receive signal from modem to enable/disable
	SAR sensor
```

## drivers/soc/Kconfig
```kconfig
menu "SOC (System On Chip) specific Drivers"

source "drivers/soc/bcm/Kconfig"
source "drivers/soc/fsl/qbman/Kconfig"
source "drivers/soc/fsl/qe/Kconfig"
source "drivers/soc/mediatek/Kconfig"
source "drivers/soc/qcom/Kconfig"
source "drivers/soc/rockchip/Kconfig"
source "drivers/soc/samsung/Kconfig"
source "drivers/soc/sunxi/Kconfig"
source "drivers/soc/tegra/Kconfig"
source "drivers/soc/ti/Kconfig"
source "drivers/soc/ux500/Kconfig"
source "drivers/soc/versatile/Kconfig"
#ifdef VENDOR_EDIT
# Bin.Li@EXP.BSP.bootloader.bootflow, 2017/05/15, Add for oppo device info and oppo project
source "drivers/soc/oppo/Kconfig"
#endif /*VENDOR_EDIT*/
endmenu
```

## drivers/soc/oppo/oppo_als_cali_value/Kconfig
```kconfig
config OPPO_ALS_CALI
	bool "config oppo als cali"
	help
		define this config to compile oppo_als_cali_value.c for device register
```
